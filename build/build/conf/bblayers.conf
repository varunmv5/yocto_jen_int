## build/build/conf/bblayers.conf
```bitbake
# POKY_BBLAYERS_CONF_VERSION is increased each time build/conf/bblayers.conf
# changes incompatibly
POKY_BBLAYERS_CONF_VERSION = "2"

BBPATH = "${TOPDIR}"
BBFILES ?= ""

BBLAYERS ?= " \
  /home/varun/yocto_jen_int/poky-morty-16.0.1/meta \
  /home/varun/yocto_jen_int/poky-morty-16.0.1/meta-poky \
  /home/varun/yocto_jen_int/poky-morty-16.0.1/meta-yocto-bsp \
  /home/varun/yocto_jen_int/meta-lab2-qemux86-64 \
  /home/varun/yocto_jen_int/meta-qt5 \
  "
```

## meta-lab2-qemux86-64/conf/layer.conf
```bitbake
# We have a conf and classes directory, add to BBPATH
BBPATH := "${BBPATH}:${LAYERDIR}"

# We have a recipes directory, add to BBFILES
BBFILES := "${BBFILES} ${LAYERDIR}/recipes-*/*/*.bb \
	${LAYERDIR}/recipes-*/*/*.bbappend"

BBFILE_COLLECTIONS += "lab2-qemux86-64"
BBFILE_PATTERN_lab2-qemux86-64 := "^${LAYERDIR}/"
BBFILE_PRIORITY_lab2-qemux86-64 = "6"
```
